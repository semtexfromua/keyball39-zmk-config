/*
 * SPDX-License-Identifier: MIT
 */

#include "keyball39.dtsi"
#include "keyball39_pmw3610.dtsi"

&kscan0 {
    col-gpios
        = <&pro_micro 4 GPIO_ACTIVE_HIGH>
        , <&pro_micro 5 GPIO_ACTIVE_HIGH>
        , <&pro_micro 6 GPIO_ACTIVE_HIGH>
        , <&pro_micro 7 GPIO_ACTIVE_HIGH>
        , <&pro_micro 8 GPIO_ACTIVE_HIGH>
        , <&pro_micro 9 GPIO_ACTIVE_HIGH>
        ;
};

/* PMW3610 device object must exist for linker (keymap references &trackball).
 * No physical sensor on left — driver init fails gracefully (data->ready=false). */
&spi1 {
    status = "okay";
};

&trackball {
    status = "okay";
};
