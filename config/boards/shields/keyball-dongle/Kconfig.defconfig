## config/boards/shields/keyball-dongle/Kconfig.defconfig
```kconfig
if SHIELD_KBALL39_DONGLE_LEFT || SHIELD_KBALL39_DONGLE_RIGHT || SHIELD_KBALL39_DONGLE

config ZMK_KEYBOARD_NAME
	default "KBall39 Dongle"

config ZMK_SPLIT
	default y

endif

if SHIELD_KBALL39_DONGLE

config ZMK_SPLIT_ROLE_CENTRAL
	default y

config ZMK_SPLIT_BLE_CENTRAL_PERIPHERALS
	default 2

config BT_MAX_CONN
	default 7

config BT_MAX_PAIRED
	default 7

endif
```

## config/boards/shields/keyball-dongle/Kconfig.shield
```kconfig
config SHIELD_KBALL39_DONGLE_LEFT
    def_bool $(shields_list_contains,kball39_dongle_left)

config SHIELD_KBALL39_DONGLE_RIGHT
    def_bool $(shields_list_contains,kball39_dongle_right)

config SHIELD_KBALL39_DONGLE
    def_bool $(shields_list_contains,kball39_dongle)
```

## config/boards/shields/keyball_nano/Kconfig.defconfig
```kconfig
if SHIELD_KEYBALL39_RIGHT

config ZMK_KEYBOARD_NAME
	default "Keyball39"

endif

if SHIELD_KEYBALL39_DONGLE

config ZMK_KEYBOARD_NAME
	default "KBall39 Dongle"

config ZMK_SPLIT_ROLE_CENTRAL
	default y

config ZMK_SPLIT_BLE_CENTRAL_PERIPHERALS
	default 2

config BT_MAX_CONN
	default 7

config BT_MAX_PAIRED
	default 7

endif

if SHIELD_KEYBALL39_LEFT || SHIELD_KEYBALL39_RIGHT || SHIELD_KEYBALL39_DONGLE

config ZMK_SPLIT
	default y
	
endif
```

## config/west.yml
```yaml
manifest:
  remotes:
    - name: zmkfirmware
      url-base: https://github.com/zmkfirmware
    - name: badjeff
      url-base: https://github.com/badjeff
    - name: semtexfromua
      url-base: https://github.com/semtexfromua
    - name: kevinpastor
      url-base: https://github.com/kevinpastor
  projects:
    - name: zmk
      remote: zmkfirmware
      revision: v0.3.0
      import: app/west.yml
    - name: zmk-pmw3610-driver
      remote: badjeff
      revision: main
    - name: zmk-split-peripheral-input-relay
      remote: badjeff
      revision: main
    - name: zmk-input-behavior-listener-custom
      remote: semtexfromua
      revision: f915f593bd63c9e8b45cb763b6c87ccd6a2aa465  # scroll-axis-lock @ 2026-06-12 (axis-locked scroll + dead-zone fix + lockout-ms)
    - name: nice-view-elemental
      remote: kevinpastor
      revision: 69c2ecd56b0b870ddb94b79110ef5a2152ca4a3a
  self:
    path: config
```
