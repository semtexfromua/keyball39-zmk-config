/*
 * SPDX-License-Identifier: MIT
 * Dongle build: LEFT half is a peripheral (no trackball).
 */

#include "keyball39.dtsi"
#include "keyball39_pmw3610.dtsi"

&kscan0 {
    col-gpios
        = <&pro_micro 4 GPIO_ACTIVE_HIGH>
        , <&pro_micro 5 GPIO_ACTIVE_HIGH>
        , <&pro_micro 6 GPIO_ACTIVE_HIGH>
        , <&pro_micro 7 GPIO_ACTIVE_HIGH>
        , <&pro_micro 8 GPIO_ACTIVE_HIGH>
        , <&pro_micro 9 GPIO_ACTIVE_HIGH>
        ;
};

/ {
    /* virtual device must exist so the shared keymap (which points at
       &vtrackball in dongle format) compiles on this half too */
    vtrackball: virtual_input_trackball {
        compatible = "zmk,virtual-input";
    };
};
